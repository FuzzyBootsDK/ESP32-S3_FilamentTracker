## sdkconfig.defaults
```kconfig
# ESP32-S3 specific
CONFIG_IDF_TARGET="esp32s3"
CONFIG_ESP32S3_DEFAULT_CPU_FREQ_240=y

# Flash size 16 MB
CONFIG_ESPTOOLPY_FLASHSIZE_16MB=y
CONFIG_ESPTOOLPY_FLASHSIZE="16MB"
CONFIG_PARTITION_TABLE_CUSTOM=y
CONFIG_PARTITION_TABLE_CUSTOM_FILENAME="partitions.csv"

# PSRAM (Octal PSRAM on S3)
CONFIG_SPIRAM=y
CONFIG_SPIRAM_MODE_OCT=y
CONFIG_SPIRAM_SPEED_80M=y
CONFIG_SPIRAM_USE_CAPS_ALLOC=y
CONFIG_SPIRAM_MALLOC_ALWAYSINTERNAL=4096

# HTTP server
CONFIG_HTTPD_MAX_URI_HANDLERS=64
CONFIG_HTTPD_MAX_REQ_HDR_LEN=1024
CONFIG_HTTPD_MAX_RESP_HDR_LEN=1024
CONFIG_HTTPD_WS_SUPPORT=y
CONFIG_HTTPD_PURGE_CONNECTIONS=y
CONFIG_HTTPD_MAX_OPEN_SOCKETS=10

# Main task stack
CONFIG_ESP_MAIN_TASK_STACK_SIZE=8192

# Logging
CONFIG_LOG_DEFAULT_LEVEL_INFO=y

# Wi-Fi
CONFIG_ESP_WIFI_STATIC_RX_BUFFER_SIZE=16
CONFIG_ESP_WIFI_DYNAMIC_RX_BUFFER_SIZE=64
CONFIG_LWIP_MAX_SOCKETS=16

# MQTT
CONFIG_MQTT_TRANSPORT_SSL=y
CONFIG_MQTT_TRANSPORT_WEBSOCKET=y

# LittleFS — use component defaults (configured via menuconfig or idf_component.yml)
```
